## drivers/input/touchscreen/lge/Kconfig
```kconfig
#
# LGE touch core configuration
#

if INPUT_TOUCHSCREEN

menuconfig LGE_TOUCH_CORE
	bool "LGE Touch Core - Generic"
	select LGE_TOUCH_CORE_BASE
	help
	  If your plaform is generic linux, say Y

config LGE_TOUCH_CORE_BASE
	bool "LGE Touch Core Base"
	depends on SPI_MASTER && I2C

config LGE_TOUCH_FW_PATH
	string "LGE Touch Core Firmware Path"
	help
	LGE_TOUCH_FW_PATH is set to path of synaptics firmware

config LGE_MODULE_DETECT
	bool "Enable Module detection"
	default n
	help
	Feature for read device maker id, like lcd or touch maker

source "drivers/input/touchscreen/lge/synaptics/Kconfig"
endif
```
